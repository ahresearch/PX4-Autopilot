## src/examples/attack/Kconfig
```kconfig
menuconfig EXAMPLES_ATTACK
	bool "attack"
	default n
	---help---
		Enable support for attack
```

## src/examples/component_manager/Kconfig
```kconfig
menuconfig EXAMPLES_COMPONENT_MANAGER
	bool "component_manager"
	default n
	---help---
		Enable support for component_manager 
```

## src/examples/px4_dynamic_app/Kconfig
```kconfig
menuconfig EXAMPLES_PX4_DYNAMIC_APP
	bool "px4_dynamic_app"
	default n
	---help---
		Enable support for px4_dynamic_app
```

## src/modules/custommodule/Kconfig
```kconfig
menuconfig MODULES_CUSTOMMODULE
	bool "custommodule"
	default n
	---help---
		Enable support for custommodule 
```

## src/modules/dataman_backup/Kconfig
```kconfig
menuconfig MODULES_DATAMAN_BACKUP
	bool "dataman_backup"
	default n
	---help---
		Enable support for dataman_backup
```

## src/modules/ekf2_backup/Kconfig
```kconfig
menuconfig MODULES_EKF2_BACKUP
	bool "ekf2_backup"
	default n
	---help---
		Enable support for ekf2_backup
```

## src/modules/logger_backup/Kconfig
```kconfig
menuconfig MODULES_LOGGER_BACKUP
	bool "logger_backup"
	default n
	---help---
		Enable support for logger_backup
```

## src/modules/mc_att_control_backup/Kconfig
```kconfig
menuconfig MODULES_MC_ATT_CONTROL_BACKUP
	bool "mc_att_control_backup"
	default n
	---help---
		Enable support for mc_att_control_backup
```

## src/modules/mc_att_control_custom/Kconfig
```kconfig
menuconfig MODULES_MC_ATT_CONTROL_CUSTOM
	bool "mc_att_control_custom"
	default n
	---help---
		Enable support for mc_att_control_custom
```

## src/modules/mc_pos_control_backup/Kconfig
```kconfig
menuconfig MODULES_MC_POS_CONTROL_BACKUP
	bool "mc_pos_control_backup"
	default n
	---help---
		Enable support for mc_pos_control_backup
```

## src/modules/mc_rate_control_backup/Kconfig
```kconfig
menuconfig MODULES_MC_RATE_CONTROL_BACKUP
	bool "mc_rate_control_backup"
	default n
	---help---
		Enable support for mc_rate_control_backup
```
